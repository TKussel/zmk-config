## config/west.yml
```yaml
manifest:
  remotes:
    - name: zmkfirmware
      url-base: https://github.com/zmkfirmware
    - name: zmkfirmware-infused-kim
      url-base: https://github.com/infused-kim
    - name: zmkfirmware-tkussel
      url-base: https://github.com/tkussel
  projects:
    # - name: zmk
    #   remote: zmkfirmware
    #   revision: main
    #   import: app/west.yml
    - name: zmk
      remote: zmkfirmware-infused-kim
      revision: sofle
      import: app/west.yml
  self:
    path: config
```
